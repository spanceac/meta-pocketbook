## meta-pocketbook/conf/machine/pocketbook-basic3-a13.conf
```bitbake
#@TYPE: Machine
#@NAME: Pocketbook Basic 3
#@DESCRIPTION: Machine configuration for the Pocketbook Basic 3 e-reader

require conf/machine/include/sun5i.inc

KERNEL_DEVICETREE = "sun5i-a13-pocketbook-touch-lux-3.dtb"
KBUILD_DEFCONFIG = "sunxi_defconfig"

UBOOT_MACHINE = "A13-OLinuXino_config"

PREFERRED_VERSION_linux-mainline = "6.1.%"

MACHINE_FEATURES = "usbhost vfat"

CORE_IMAGE_EXTRA_INSTALL += "rtl8188eus"
```
